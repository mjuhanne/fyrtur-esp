## esp32/sdkconfig.defaults
```kconfig
# Set OTA partitions
CONFIG_PARTITION_TABLE_TWO_OTA=y
CONFIG_PARTITION_TABLE_CUSTOM_FILENAME="partitions.csv"
CONFIG_PARTITION_TABLE_OFFSET=0x8000
CONFIG_PARTITION_TABLE_FILENAME="partitions_two_ota.csv"

# Allow OTA update via normal HTTP
CONFIG_OTA_ALLOW_HTTP=y

# Required by mdns via wifi manager
CONFIG_LWIP_IPV6=y

# OTA requires 4MB flash (available on ESP32 WROVER-B)
CONFIG_ESPTOOLPY_FLASHSIZE_4MB=y
CONFIG_ESPTOOLPY_FLASHSIZE="4MB"

# Timer stack needs to be larger
CONFIG_FREERTOS_TIMER_TASK_STACK_DEPTH=3072

# System event stack needs to be larger
CONFIG_ESP_SYSTEM_EVENT_TASK_STACK_SIZE=3072
```

## esp8266/sdkconfig.defaults
```kconfig
# Sparkfun FT232RL adapter on Mac OS X
CONFIG_ESPTOOLPY_PORT="/dev/tty.usbserial-A40081Ws"

# Set OTA partitions
CONFIG_PARTITION_TABLE_TWO_OTA=y
CONFIG_PARTITION_TABLE_CUSTOM_FILENAME="partitions.csv"
CONFIG_PARTITION_TABLE_OFFSET=0x8000
CONFIG_PARTITION_TABLE_FILENAME="partitions_two_ota.csv"

# Allow OTA update via normal HTTP
CONFIG_OTA_ALLOW_HTTP=y

# Required by mdns via wifi manager
CONFIG_LWIP_IPV6=y
```
